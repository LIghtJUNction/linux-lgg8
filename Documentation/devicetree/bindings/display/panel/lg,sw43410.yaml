## Documentation/devicetree/bindings/display/panel/lg,sw43410.yaml
```yaml
# SPDX-License-Identifier: (GPL-2.0-only OR BSD-2-Clause)
%YAML 1.2
---
$id: http://devicetree.org/schemas/display/panel/lg,sw43410.yaml#
$schema: http://devicetree.org/meta-schemas/core.yaml#

title: LG SW43410 1440x3120 AMOLED panel

maintainers:
  - LIghtJUNction <106986785+LIghtJUNction@users.noreply.github.com>

description: |
  Four-lane DSI command-mode panel used by the LG G8 ThinQ Alpha_lao.
  The panel uses DSC 1.1 SCR1 with two 720-pixel slices. This binding
  describes the experimental driver in the LG G8 kernel tree.

allOf:
  - $ref: panel-common.yaml#

properties:
  compatible:
    const: lg,sw43410
  reg:
    maxItems: 1
  port: true
  vddi-supply: true
  vpnl-supply: true
  reset-gpios:
    maxItems: 1

required:
  - compatible
  - reg
  - vddi-supply
  - vpnl-supply
  - reset-gpios
  - port

additionalProperties: false

examples:
  - |
    #include <dt-bindings/gpio/gpio.h>
    dsi {
        #address-cells = <1>;
        #size-cells = <0>;
        panel@0 {
            compatible = "lg,sw43410";
            reg = <0>;
            vddi-supply = <&vreg_l14a_1p8>;
            vpnl-supply = <&vreg_l17a_3p0>;
            reset-gpios = <&tlmm 6 GPIO_ACTIVE_LOW>;
            port {
                endpoint {
                    remote-endpoint = <&mdss_dsi0_out>;
                };
            };
        };
    };
...
```

## Documentation/devicetree/bindings/input/touchscreen/lge,sw42000.yaml
```yaml
# SPDX-License-Identifier: (GPL-2.0-only OR BSD-2-Clause)
%YAML 1.2
---
$id: http://devicetree.org/schemas/input/touchscreen/lge,sw42000.yaml#
$schema: http://devicetree.org/meta-schemas/core.yaml#

title: LG SW42000 I2C Touchscreen Controller

maintainers:
  - LIghtJUNction <lightjunction.me@gmail.com>

allOf:
  - $ref: touchscreen.yaml#

description: |
  The SW42000 touchscreen controller used by the LG G8 ThinQ. The controller
  uses a vendor-specific I2C register protocol and reports up to ten contacts.
  Firmware updates are intentionally outside this binding and driver.

properties:
  compatible:
    const: lge,sw42000

  reg:
    maxItems: 1

  interrupts:
    maxItems: 1

  reset-gpios:
    maxItems: 1

  vdd-gpios:
    maxItems: 1

  vcl-gpios:
    maxItems: 1

  pinctrl-names:
    items:
      - const: default

  pinctrl-0: true

unevaluatedProperties: false

required:
  - compatible
  - reg
  - interrupts
  - reset-gpios
  - vdd-gpios
  - vcl-gpios
  - touchscreen-size-x
  - touchscreen-size-y

examples:
  - |
    #include <dt-bindings/gpio/gpio.h>
    #include <dt-bindings/interrupt-controller/irq.h>

    i2c {
        #address-cells = <1>;
        #size-cells = <0>;

        touchscreen@28 {
            compatible = "lge,sw42000";
            reg = <0x28>;
            interrupt-parent = <&tlmm>;
            interrupts = <122 IRQ_TYPE_EDGE_FALLING>;
            reset-gpios = <&tlmm 54 GPIO_ACTIVE_HIGH>;
            vdd-gpios = <&tlmm 152 GPIO_ACTIVE_HIGH>;
            vcl-gpios = <&tlmm 59 GPIO_ACTIVE_HIGH>;
            touchscreen-size-x = <1440>;
            touchscreen-size-y = <3120>;
        };
    };

...
```

## Documentation/devicetree/bindings/power/supply/qcom,pm8150b-charger.yaml
```yaml
# SPDX-License-Identifier: GPL-2.0 OR BSD-2-Clause
%YAML 1.2
---
$id: http://devicetree.org/schemas/power/supply/qcom,pm8150b-charger.yaml#
$schema: http://devicetree.org/meta-schemas/core.yaml#

title: Qualcomm PM8150B SMB5 charger status

maintainers:
  - Casey Connolly <casey.connolly@linaro.org>

description:
  The PM8150B SMB5 charger function. A status driver can report USB presence,
  power-path selection and, when supplied, the MID_CHG ADC voltage. It does
  not configure the charger or control charging.

properties:
  compatible:
    const: qcom,pm8150b-charger

  reg:
    maxItems: 1

  io-channels:
    maxItems: 1
    description: |
      The single ADC5_MID_CHG_DIV6 channel of a qcom,spmi-adc5 provider at
      register base 0x3100 under the same PM8150B node as this charger. The
      provider must have exactly one available child with that channel's reg.
      Its qcom,pre-scaling must be <1 6>, or omitted to use ADC5's 1/6 default.
      ADC5 reports this processed voltage in microvolts; another IIO voltage
      provider cannot be substituted based on its channel name or type alone.
      The consumer driver validates the referenced topology before registering
      its power supply. These cross-node constraints are not schema-enforced.

  io-channel-names:
    items:
      - const: mid-chg

  status:
    enum:
      - disabled
      - okay

required:
  - compatible
  - reg

dependentRequired:
  io-channels: [io-channel-names]
  io-channel-names: [io-channels]

additionalProperties: false

examples:
  - |
    #include <dt-bindings/spmi/spmi.h>

    spmi {
      #address-cells = <2>;
      #size-cells = <0>;

      pmic@2 {
        compatible = "qcom,pm8150b", "qcom,spmi-pmic";
        reg = <0x2 SPMI_USID>;
        #address-cells = <1>;
        #size-cells = <0>;

        charger@1000 {
          compatible = "qcom,pm8150b-charger";
          reg = <0x1000>;
          status = "disabled";
        };
      };
    };
...
```

## Documentation/devicetree/bindings/power/supply/qcom,pm8150b-fg-observer.yaml
```yaml
# SPDX-License-Identifier: (GPL-2.0-only OR BSD-2-Clause)
%YAML 1.2
---
$id: http://devicetree.org/schemas/power/supply/qcom,pm8150b-fg-observer.yaml#
$schema: http://devicetree.org/meta-schemas/core.yaml#

title: Qualcomm PM8150B battery information observer

maintainers:
  - Casey Connolly <casey.connolly@linaro.org>

description: |
  Read-only observation of battery-info and memory-interface status registers,
  and experimental raw ADC_RR registers. The raw ADC_RR values do not establish
  a validated battery temperature. This node does not initialize the fuel gauge
  or control charging.
  The battery-information and memory-interface peripheral subtypes are checked
  before registration. If the optional ADC_RR peripheral is supplied, its subtype
  is also checked and its battery-missing status provides the power-supply PRESENT
  property. Two-address nodes do not expose PRESENT. Read errors are propagated;
  presence does not establish valid temperature, calibration or charging safety.

properties:
  compatible:
    const: qcom,pm8150b-fg-observer

  reg:
    minItems: 2
    items:
      - description: Battery-information peripheral base
      - description: Fuel-gauge memory-interface peripheral base
      - description: |
          Optional fuel-gauge ADC_RR peripheral base for battery presence and
          experimental raw reads

  status: true

required:
  - compatible
  - reg

additionalProperties: false

examples:
  - |
    #include <dt-bindings/spmi/spmi.h>

    spmi {
      #address-cells = <2>;
      #size-cells = <0>;

      pmic@2 {
        compatible = "qcom,pm8150b", "qcom,spmi-pmic";
        reg = <0x2 SPMI_USID>;
        #address-cells = <1>;
        #size-cells = <0>;

        battery-info@4100 {
          compatible = "qcom,pm8150b-fg-observer";
          reg = <0x4100>, <0x4300>, <0x4200>;
          status = "disabled";
        };
      };
    };
...
```
